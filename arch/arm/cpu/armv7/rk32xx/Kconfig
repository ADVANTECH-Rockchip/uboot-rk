## arch/arm/cpu/armv7/rk32xx/Kconfig
```kconfig
if ROCKCHIP_ARCH32

config ROCKCHIP
	bool

choice
	prompt "rockchip platform select"

config PLAT_RK32XX
	bool "rk32xx platform"
	select ROCKCHIP

config PLAT_RK30XX
	bool "rk30xx platform"
	select ROCKCHIP

config PLAT_RSB4680A1_2G
	bool "Support rk3288 rsb4680a101-1 2G"
	select ROCKCHIP
	select ARCH_ADVANTECH
	
config PLAT_RSB4680A2_2G
	bool "Support rk3288 rsb4680a102-1 2G"
	select ROCKCHIP
	select ARCH_ADVANTECH
	
config PLAT_RSB4680A3_2G
	bool "Support rk3288 rsb4680a102-1 2G"
	select ROCKCHIP
	select ARCH_ADVANTECH

config PLAT_EBCRB03A1_2G
	bool "Support rk3288 ebcrb03a101-1 2G"
	select ROCKCHIP
	select ARCH_ADVANTECH

config PLAT_EBCRB03A2_2G
	bool "Support rk3288 ebcrb03a102-1 2G"
	select ROCKCHIP
	select ARCH_ADVANTECH

config PLAT_USM110A2_2G
	bool "Support rk3288 usm110a102-1 2G"
	select ROCKCHIP
	select ARCH_ADVANTECH

config PLAT_USC130160A1_2G
	bool "Support rk3288 usc130160a101-1 2G"
	select ROCKCHIP
	select ARCH_ADVANTECH

endchoice


config SYS_CPU
	default "armv7"

config SYS_SOC
	default "rk32xx"

source "board/rockchip/rk32xx/Kconfig"
source "board/rockchip/advantech/Kconfig"

endif
```

## board/rockchip/advantech/Kconfig
```kconfig
if ROCKCHIP_ARCH32

config ARCH_ADVANTECH
	bool "Support Advantech platform"

if ARCH_ADVANTECH

config SYS_BOARD
	default "advantech"

config SYS_VENDOR
	default "rockchip"

if PLAT_EBCRB03A1_2G || PLAT_EBCRB03A2_2G

config SYS_CONFIG_NAME
	default "rk3288_ebcrb03"

endif

if PLAT_RSB4680A1_2G || PLAT_RSB4680A2_2G || PLAT_RSB4680A3_2G

config SYS_CONFIG_NAME
	default "rk3288_rsb4680"

endif

if PLAT_USM110A2_2G

config SYS_CONFIG_NAME
	default "rk3288_usm110"

endif

if PLAT_USC130160A1_2G

config SYS_CONFIG_NAME
	default "rk3288_usc130160"

endif

endif

endif
```

## board/rockchip/rk32xx/Kconfig
```kconfig
if ROCKCHIP_ARCH32

if PLAT_RK32XX

config SYS_BOARD
	default "rk32xx"

config SYS_VENDOR
	default "rockchip"

config SYS_CONFIG_NAME
	default "rk32plat"

endif

if PLAT_RK30XX

config SYS_BOARD
	default "rk32xx"

config SYS_VENDOR
	default "rockchip"

config SYS_CONFIG_NAME
	default "rk30plat"

endif

endif
```

## configs/rk3288_rsb4680a3_2G_defconfig
```kconfig
CONFIG_SYS_EXTRA_OPTIONS="RKCHIP_RK3288,PRODUCT_MID,NORMAL_WORLD,SECOND_LEVEL_BOOTLOADER"
CONFIG_ARM=y
CONFIG_ROCKCHIP_ARCH32=y
CONFIG_PLAT_RSB4680A3_2G=y
# CONFIG_SYS_MALLOC_CLEAR_ON_INIT is not set
```

## configs/rk3288_usc130160a1_2G_defconfig
```kconfig
CONFIG_SYS_EXTRA_OPTIONS="RKCHIP_RK3288,PRODUCT_MID"
CONFIG_ARM=y
CONFIG_ROCKCHIP_ARCH32=y
CONFIG_PLAT_USC130160A1_2G=y
# CONFIG_SYS_MALLOC_CLEAR_ON_INIT is not set
```
